#include "stm32f407xx.h"
int i = 0;
void TIM6_DAC_IRQHandler(){

	TIM6->SR &= ~TIM_SR_UIF;
	
	if(i==0) GPIOD->ODR|=GPIO_ODR_OD12;
	else if(i==1) GPIOD->ODR|=GPIO_ODR_OD13;
	else if(i==2) GPIOD->ODR|=GPIO_ODR_OD14;
	else if(i==3) GPIOD->ODR|=GPIO_ODR_OD15;
	else if(i==4)GPIOD->ODR&=~(GPIO_ODR_OD12|GPIO_ODR_OD13|GPIO_ODR_OD14|GPIO_ODR_OD15);
	i++;
	if(i==5) i=0;
}

int main(){
	RCC->AHB1ENR|=RCC_AHB1ENR_GPIODEN;
	GPIOD->MODER|=(GPIO_MODER_MODER12_0|GPIO_MODER_MODER13_0|GPIO_MODER_MODER14_0|GPIO_MODER_MODER15_0);
	GPIOD->MODER|=(GPIO_MODER_MODER12_0);
	GPIOD->MODER|=(GPIO_MODER_MODER13_0);
	
	RCC->APB1ENR|=RCC_APB1ENR_TIM6EN;
	
	TIM6->PSC = 24000 - 1;
	TIM6->ARR = 100;
	TIM6->DIER |= TIM_DIER_UIE;
	NVIC_EnableIRQ(TIM6_DAC_IRQn);
	
  TIM6->CR1 = TIM_CR1_CEN;
	while(1){}
	
}
